## Kconfig
```kconfig
#
# Copyright (c) 2019 Nordic Semiconductor ASA
#
# SPDX-License-Identifier: LicenseRef-Nordic-5-Clause
#

#
# Copyright (c) 2018 Nordic Semiconductor ASA
#
# SPDX-License-Identifier: LicenseRef-Nordic-5-Clause
#

menu "Sound"

config APPLICATION_WORKQUEUE_STACK_SIZE
	int "Application workqueue stack size"
	default 4096

config APPLICATION_WORKQUEUE_PRIORITY
	int "Application workqueue priority"
	default SYSTEM_WORKQUEUE_PRIORITY

menu "Device and modem"

config POWER_OPTIMIZATION_ENABLE
	bool "Enable power optimization"
	default y
	select LTE_EDRX_REQ

endmenu # Device

menuconfig LIGHT_SENSOR
	bool "Light sensor"
	select BH1749 if BOARD_THINGY91_NRF9160NS
	default y if BOARD_THINGY91_NRF9160NS

endmenu

menu "Zephyr Kernel"
source "Kconfig.zephyr"
endmenu

## From UI

config USE_UI_MODULE
	bool "Enable UI module"
	default y
	help
		Enable the User Interface module for user interaction on
		development kit / Thingy91 hardware.

menu "User Interface"
	visible if USE_UI_MODULE

config UI_BUZZER
	bool "Enable buzzer"
	default y if BOARD_THINGY91_NRF9160NS
	select PWM if BOARD_THINGY91_NRF9160NS
	select PWM_1 if BOARD_THINGY91_NRF9160NS

if UI_BUZZER

config UI_BUZZER_PWM_DEV_NAME
	string "PWM device name for buzzer"
	default "PWM_1" if BOARD_THINGY91_NRF9160NS

config UI_BUZZER_PIN
	int "Buzzer pin number"
	default 28 if BOARD_THINGY91_NRF9160NS

config UI_BUZZER_MIN_FREQUENCY
	int "Minimum buzzer frequency"
	default 100

config UI_BUZZER_MAX_FREQUENCY
	int "Maximum buzzer frequency"
	default 10000

endif # UI_BUZZER

endmenu

module = UI
module-str = User Interface
source "${ZEPHYR_BASE}/subsys/logging/Kconfig.template.log_config"
```

## build_thingy91_nrf9160ns/mcuboot/Kconfig/Kconfig.modules
```kconfig
menu "nrf (C:\Users\helo\v1.6.0\nrf)"
osource "C:/Users/helo/v1.6.0/nrf/Kconfig.nrf"
config ZEPHYR_NRF_MODULE
	bool
	default y
endmenu
menu "mcuboot (C:\Users\helo\v1.6.0\bootloader\mcuboot)"
osource "$(ZEPHYR_MCUBOOT_KCONFIG)"
config ZEPHYR_MCUBOOT_MODULE
	bool
	default y
endmenu
menu "trusted-firmware-m (C:\Users\helo\v1.6.0\modules\tee\tfm)"
osource "$(ZEPHYR_TRUSTED_FIRMWARE_M_KCONFIG)"
config ZEPHYR_TRUSTED_FIRMWARE_M_MODULE
	bool
	default y
endmenu
menu "cjson (C:\Users\helo\v1.6.0\modules\lib\cjson)"
osource "$(ZEPHYR_CJSON_KCONFIG)"
config ZEPHYR_CJSON_MODULE
	bool
	default y
endmenu
menu "pelion-dm (C:\Users\helo\v1.6.0\modules\lib\pelion-dm)"
osource "C:/Users/helo/v1.6.0/modules/lib/pelion-dm/zephyr/Kconfig"
config ZEPHYR_PELION_DM_MODULE
	bool
	default y
endmenu
menu "cddl-gen (C:\Users\helo\v1.6.0\modules\lib\cddl-gen)"
osource "$(ZEPHYR_CDDL_GEN_KCONFIG)"
config ZEPHYR_CDDL_GEN_MODULE
	bool
	default y
endmenu
menu "memfault-firmware-sdk (C:\Users\helo\v1.6.0\modules\lib\memfault-firmware-sdk)"
osource "C:/Users/helo/v1.6.0/modules/lib/memfault-firmware-sdk/ports/zephyr/Kconfig"
config ZEPHYR_MEMFAULT_FIRMWARE_SDK_MODULE
	bool
	default y
endmenu
menu "hal_nordic (C:\Users\helo\v1.6.0\modules\hal\nordic)"
osource "$(ZEPHYR_HAL_NORDIC_KCONFIG)"
config ZEPHYR_HAL_NORDIC_MODULE
	bool
	default y
endmenu
menu "mbedtls (C:\Users\helo\v1.6.0\modules\crypto\mbedtls)"
osource "$(ZEPHYR_MBEDTLS_KCONFIG)"
config ZEPHYR_MBEDTLS_MODULE
	bool
	default y
endmenu
menu "TraceRecorder (C:\Users\helo\v1.6.0\modules\debug\TraceRecorder)"
osource "C:/Users/helo/v1.6.0/modules/debug/TraceRecorder/kernelports/Zephyr/Kconfig"
config ZEPHYR_TRACERECORDER_MODULE
	bool
	default y
endmenu
menu "nrfxlib (C:\Users\helo\v1.6.0\nrfxlib)"
osource "C:/Users/helo/v1.6.0/nrfxlib/Kconfig.nrfxlib"
config ZEPHYR_NRFXLIB_MODULE
	bool
	default y
endmenu
menu "connectedhomeip (C:\Users\helo\v1.6.0\modules\lib\matter)"
osource "C:/Users/helo/v1.6.0/modules/lib/matter/config/nrfconnect/chip-module/Kconfig"
config ZEPHYR_CONNECTEDHOMEIP_MODULE
	bool
	default y
endmenu
```

## build_thingy91_nrf9160ns/mcuboot/Kconfig/Kconfig.shield.defconfig
```kconfig
osource "C:/Users/helo/v1.6.0/nrf/boards/shields/*/Kconfig.defconfig"
osource "C:/Users/helo/v1.6.0/zephyr/boards/shields/*/Kconfig.defconfig"
```

## build_thingy91_nrf9160ns/mcuboot/Kconfig/Kconfig.soc.arch
```kconfig
osource "C:/Users/helo/v1.6.0/zephyr/soc/$(ARCH)/Kconfig"
osource "C:/Users/helo/v1.6.0/zephyr/soc/$(ARCH)/*/Kconfig"
```

## build_thingy91_nrf9160ns/spm/Kconfig/Kconfig.shield
```kconfig
osource "C:/Users/helo/v1.6.0/nrf/boards/shields/*/Kconfig.shield"
osource "C:/Users/helo/v1.6.0/zephyr/boards/shields/*/Kconfig.shield"
```
